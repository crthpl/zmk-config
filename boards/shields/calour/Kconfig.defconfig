## boards/shields/calour/Kconfig.defconfig
```kconfig
if SHIELD_CALOUR_LEFT

config ZMK_KEYBOARD_NAME
    default "calour"

config ZMK_SPLIT_ROLE_CENTRAL
    default y

endif # SHIELD_CALOUR_LEFT

if SHIELD_CALOUR_LEFT || SHIELD_CALOUR_RIGHT

config ZMK_SPLIT
    default y

endif # SHIELD_CALOUR_LEFT || SHIELD_CALOUR_RIGHT
```

## boards/shields/calour/Kconfig.shield
```kconfig
config SHIELD_CALOUR_LEFT
    def_bool $(shields_list_contains,calour_left)

config SHIELD_CALOUR_RIGHT
    def_bool $(shields_list_contains,calour_right)
```

## config/west.yml
```yaml
manifest:
  defaults:
    remote: urob
    revision: v0.2 # Pin everything to v0.2

  remotes:
    - name: zmkfirmware
      url-base: https://github.com/zmkfirmware
    # Additional modules containing boards/shields/custom code can be listed here as well
    # See https://docs.zephyrproject.org/3.2.0/develop/west/manifest.html#projects
    - name: urob
      url-base: https://github.com/urob

  projects:
    - name: zmk
      remote: zmkfirmware
      revision: main
      import: app/west.yml
    - name: zmk-helpers
      remote: urob
      revision: main
  self:
    path: config
```
