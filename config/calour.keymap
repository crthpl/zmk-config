#include <behaviors.dtsi>
#include <dt-bindings/zmk/keys.h>

#include <dt-bindings/zmk/bt.h>
#include <dt-bindings/zmk/outputs.h>

#include "zmk-helpers/helper.h"
#include "zmk-helpers/key-labels/36.h"

/*

TO TYPE:
Symbols: ~`@#$%^&*-_=+/\|;:'",.?! (Number of symbols: 24)
    Shifting Behaviour:
      ` -> ~

Paran: []<>{}() (Number of symbols: 8)
    Shifting Behaviour:
      () -> <>
      [] -> {}
      ,

Alphas: 26
Numbers: 10 (Shift turns into numpad)

Combo Possibilities:
Vertical: 2 per column incl. thumbs, so 2/col * 6col/side * 2 sides = 24
Horizontal: Index finger has 3/side, Pinky/Ring has 2/side, so (2/3)*2 = 10
Multi: Middle/Ring has 3/side, so 2*3 = 6
Homerow: 8 keys total, so 8C2 = 28
Homerow full chording: 219 combinations

24+10+6+28 = 68

*/

#define DEF 0

#define NAV 1
#define NUM 2

#define SYS 3
#define MOUSE 4

#define FIVE 5
#define SIX 6

#define XXX &none
#define ___ &trans

#define KEYS_L LT0 LT1 LT2 LT3 LT4 LM0 LM1 LM2 LM3 LM4 LB0 LB1 LB2 LB3 LB4  // left hand
#define KEYS_R RT0 RT1 RT2 RT3 RT4 RM0 RM1 RM2 RM3 RM4 RB0 RB1 RB2 RB3 RB4  // right hand
#define THUMBS LH2 LH1 LH0 RH0 RH1 RH2                                      // thumbs

#define MAKE_HRM(NAME, HOLD, TAP, TRIGGER_POS)                                 \
  ZMK_HOLD_TAP(NAME, bindings = <HOLD>, <TAP>; flavor = "balanced";            \
               tapping-term-ms = <280>; quick-tap-ms = <175>;         \
               require-prior-idle-ms = <150>; hold-trigger-on-release;         \
               hold-trigger-key-positions = <TRIGGER_POS>;)

MAKE_HRM(hml, &kp, &kp, KEYS_R THUMBS) // Left-hand HRMs.
MAKE_HRM(hmr, &kp, &kp, KEYS_L THUMBS) // Right-hand HRMs.

#ifndef ZMK_BASE_LAYER
  #define ZMK_BASE_LAYER(name, LT, RT, LM, RM, LB, RB, LH, RH)                 \
      ZMK_LAYER(name, LT RT LM RM LB RB LH RH)
#endif

ZMK_BASE_LAYER(Base,
//┌─────────────┬─────────────┬─────────────┬─────────────┬─────────────┐ ┌─────────────┬─────────────┬─────────────┬─────────────┬─────────────┐
    &kp Q            &kp W            &kp F           &kp P            &kp B          ,  &kp J            &kp L            &kp U           &kp Y            &kp SQT       ,
//├─────────────┼─────────────┼─────────────┼─────────────┼─────────────┤ ├─────────────┼─────────────┼─────────────┼─────────────┼─────────────┤
    &hml LGUI A      &hml LALT R      &hml LCTRL S    &hml LSHFT T     &kp G          ,  &kp M            &hmr LSHFT N     &hml LCTRL E    &hml LALT I      &hml LGUI O   ,
//├─────────────┼─────────────┼─────────────┼─────────────┼─────────────┤ ├─────────────┼─────────────┼─────────────┼─────────────┼─────────────┤
    &kp Z            &kp X            &kp C           &kp D            &kp V          ,  &kp K            &kp H            &kp COMMA       &kp DOT          &kp           ,
//└─────────────┴─────────────┼─────────────┼─────────────┼─────────────┤ ├─────────────┼─────────────┼─────────────┼─────────────┴─────────────┘
                                      &kp ESC         &kp SPACE        &kp TAB        ,  &kp ENTER        &kp BKSP         &kp DELETE
//                                 └─────────────┴─────────────┴─────────────┘ └─────────────┴─────────────┴─────────────┘
)
